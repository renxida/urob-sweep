// Copyright (c) 2022 The ZMK Contributors
// SPDX-License-Identifier: MIT



/* source keypos definitions */
#include "../zmk-nodefree-config/keypos_def/keypos_34keys.h"

/* activate bluetooth */
#define CONFIG_WIRELESS 1

/* source the main keymap */
#include "base_colemakdh.keymap"

/* use default transform*/
/ { chosen { zmk,matrix_transform = &default_transform; }; };

